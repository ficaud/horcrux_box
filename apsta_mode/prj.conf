## CMakeLists.txt
```
# SPDX-License-Identifier: Apache-2.0

cmake_minimum_required(VERSION 3.20.0)

find_package(Zephyr REQUIRED HINTS $ENV{ZEPHYR_BASE})
project(wifi_apsta_mode)

target_sources(app PRIVATE
    src/main.c
    src/access-point/http/src/http_server.c
    src/access-point/http/src/http_handlers.c
    src/access-point/http/src/http_types.c
    src/access-point/http/src/http_router.c
    src/access-point/net/src/dns.c
    src/access-point/net/src/dhcp.c
    src/access-point/wifi/src/wifi_mgr.c
)

# Auto-generate page_captive.h from assets (HTML + CSS)
set(ASSETS_DIR    ${CMAKE_CURRENT_SOURCE_DIR}/src/access-point/assets)
set(ASSETS_OUTPUT ${ASSETS_DIR}/page_captive.h)

add_custom_command(
    OUTPUT  ${ASSETS_OUTPUT}
    COMMAND ${PYTHON_EXECUTABLE}
            ${CMAKE_CURRENT_SOURCE_DIR}/tools/embed-assets.py
            ${ASSETS_DIR}
            ${ASSETS_OUTPUT}
    DEPENDS ${ASSETS_DIR}/index.html
            ${ASSETS_DIR}/style.css
            ${CMAKE_CURRENT_SOURCE_DIR}/tools/embed-assets.py
    COMMENT "Generating page_captive.h from assets..."
)

target_sources(app PRIVATE ${ASSETS_OUTPUT})

target_include_directories(app PRIVATE
    src/access-point/http/inc
    src/access-point/net/inc
    src/access-point/wifi/inc
    src/access-point/assets
)
```

## west.yml
```
# SPDX-License-Identifier: Apache-2.0
#
# West manifest minimal pour ESP32-S3-DevKitC-1.
# Ne télécharge que les modules strictement nécessaires au build
# Wi-Fi AP-STA sur la cible esp32s3_devkitc/esp32s3/procpu.

manifest:
  version: 0.8
  defaults:
    remote: zephyrproject

  remotes:
    - name: zephyrproject
      url-base: https://github.com/zephyrproject-rtos

  projects:
    - name: zephyr
      remote: zephyrproject
      revision: v4.4.1
      west-commands: scripts/west-commands.yml
      import:
        name-allowlist:
          - hal_espressif
          - mcuboot
          - picolibc
          - mbedtls
          - tf-psa-crypto
          - zcbor

  self:
    path: apsta_mode
```

## prj.conf
```kconfig
# Wi-Fi Configuration
CONFIG_WIFI=y
CONFIG_WIFI_NM=y
CONFIG_WIFI_USAGE_MODE_AP=y

CONFIG_WIFI_SAMPLE_AP_SSID="ESP32S3_portal"
CONFIG_WIFI_SAMPLE_AP_PSK="ubx7jrd9kje_ZRC8dqt"
CONFIG_WIFI_SAMPLE_DHCPV4_START=y
CONFIG_WIFI_SAMPLE_AP_IP_ADDRESS="192.168.4.1"
CONFIG_WIFI_SAMPLE_AP_NETMASK="255.255.255.0"

# Network Configuration
CONFIG_NET_CONFIG_AUTO_INIT=y
CONFIG_NET_CONNECTION_MANAGER=y
CONFIG_NET_DHCPV4=y
CONFIG_NET_DHCPV4_SERVER=y
CONFIG_NET_DHCPV4_SERVER_OPTION_DNS_ADDRESS="192.168.4.1"
CONFIG_NET_IF_MAX_IPV4_COUNT=2
CONFIG_NET_IF_MAX_IPV6_COUNT=2
CONFIG_NET_IPV4=y
CONFIG_NET_L2_ETHERNET=y
CONFIG_NET_L2_WIFI_MGMT=y
CONFIG_NET_MGMT=y
CONFIG_NET_MGMT_EVENT=y
CONFIG_NET_MGMT_EVENT_INFO=y
CONFIG_NET_MGMT_EVENT_QUEUE_SIZE=10
CONFIG_NET_MGMT_EVENT_STACK_SIZE=4096
CONFIG_NET_PKT_RX_COUNT=32
CONFIG_NET_PKT_TX_COUNT=32
CONFIG_NET_SOCKETS=y
CONFIG_NET_SOCKETS_SERVICE_STACK_SIZE=4096
CONFIG_NET_TCP=y
CONFIG_NET_TCP_MAX_SEND_WINDOW_SIZE=10
CONFIG_NET_TCP_MAX_RECV_WINDOW_SIZE=10
CONFIG_NET_TCP_TIME_WAIT_DELAY=500
CONFIG_ZVFS_OPEN_MAX=8
CONFIG_NET_MAX_CONTEXTS=20
CONFIG_NET_UDP=y
CONFIG_NETWORKING=y

# LOG Configuration
CONFIG_NET_LOG=y
CONFIG_NET_DHCPV4_SERVER_LOG_LEVEL_DBG=y
```

## src/main.c
```c
#include <zephyr/logging/log.h>

#include "access-point/inc/dns.h"
#include "access-point/inc/http_server.h"
#include "access-point/inc/wifi_mgr.h"

LOG_MODULE_REGISTER(MAIN);

/* ---------------------------------------------------------------------------
 * main
 * ------------------------------------------------------------------------- */

int main(void)
{
	int ret;
	// Wifi manager initlialization for AP mode
	ret = wifi_mgr_init();
	LOG_INF("Wi-Fi AP mode initialized, ret: %d", ret);

	// DNS interceptor start
	dns_interceptor_start();
	
	// HTTP server start
	http_server_start();

	LOG_INF("Captive portal started");
	return 0;
}
```
